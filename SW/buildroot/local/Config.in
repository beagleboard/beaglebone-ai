## SW/buildroot/local/configs/beagleboneai_defconfig
```kconfig
BR2_arm=y
BR2_cortex_a15=y
BR2_TOOLCHAIN_BUILDROOT_GLIBC=y
BR2_KERNEL_HEADERS_4_9=y
BR2_INIT_SYSTEMD=y
BR2_TARGET_GENERIC_ROOT_PASSWD="root"
BR2_SYSTEM_BIN_SH_BASH=y
# BR2_TARGET_GENERIC_GETTY is not set
# BR2_TARGET_GENERIC_REMOUNT_ROOTFS_RW is not set
BR2_ROOTFS_OVERLAY="${BR2_EXTERNAL_BeagleBone_AI_PATH}/board/beagleboneai/rootfs-overlay"
BR2_ROOTFS_POST_BUILD_SCRIPT="${BR2_EXTERNAL_BeagleBone_AI_PATH}/board/beagleboneai/post-build.sh"
BR2_ROOTFS_POST_IMAGE_SCRIPT="${BR2_EXTERNAL_BeagleBone_AI_PATH}/board/beagleboneai/post-image.sh"
BR2_LINUX_KERNEL=y
BR2_LINUX_KERNEL_CUSTOM_GIT=y
BR2_LINUX_KERNEL_CUSTOM_REPO_URL="https://github.com/beagleboard/linux"
BR2_LINUX_KERNEL_CUSTOM_REPO_VERSION="4.9.147-ti-r119"
BR2_LINUX_KERNEL_DEFCONFIG="bb.org"
BR2_LINUX_KERNEL_XZ=y
BR2_LINUX_KERNEL_DTS_SUPPORT=y
BR2_LINUX_KERNEL_INTREE_DTS_NAME="am57xx-beagle-x15 am335x-pocketbeagle am335x-evm am335x-bone am335x-boneblack am335x-boneblack-wireless am335x-bonegreen am335x-bonegreen-wireless am335x-abbbi am335x-boneblue am335x-sancloud-bbe am335x-evmsk am335x-boneblack-uboot"
BR2_LINUX_KERNEL_CUSTOM_DTS_PATH="${BR2_EXTERNAL_BeagleBone_AI_PATH}/board/beagleboneai/dtb/src/arm/am5729-beagleboneai.dts"
BR2_LINUX_KERNEL_INSTALL_TARGET=y
BR2_PACKAGE_ALSA_UTILS=y
BR2_PACKAGE_ALSA_UTILS_APLAY=y
BR2_PACKAGE_XZ=y
BR2_PACKAGE_BTRFS_PROGS=y
BR2_PACKAGE_E2FSPROGS=y
BR2_PACKAGE_E2FSPROGS_RESIZE2FS=y
BR2_PACKAGE_FLASHBENCH=y
BR2_PACKAGE_MMC_UTILS=y
BR2_PACKAGE_LINUX_FIRMWARE=y
BR2_PACKAGE_LINUX_FIRMWARE_TI_WL18XX=y
BR2_PACKAGE_RPI_BT_FIRMWARE=y
BR2_PACKAGE_BBORG_OVERLAYS=y
BR2_PACKAGE_BEAGLETESTER=y
BR2_PACKAGE_DEVMEM2=y
BR2_PACKAGE_EDID_DECODE=y
BR2_PACKAGE_EVTEST=y
BR2_PACKAGE_I2C_TOOLS=y
BR2_PACKAGE_MEMTESTER=y
BR2_PACKAGE_UBOOT_TOOLS=y
BR2_PACKAGE_UBOOT_TOOLS_MKENVIMAGE=y
BR2_PACKAGE_PERL=y
BR2_PACKAGE_LIBGPIOD=y
BR2_PACKAGE_LIBGPIOD_TOOLS=y
BR2_PACKAGE_CONNMAN=y
BR2_PACKAGE_CONNMAN_WIFI=y
BR2_PACKAGE_CONNMAN_BLUETOOTH=y
BR2_PACKAGE_CONNMAN_CLIENT=y
BR2_PACKAGE_DROPBEAR=y
BR2_PACKAGE_ETHTOOL=y
BR2_PACKAGE_IPERF3=y
BR2_PACKAGE_IPUTILS=y
BR2_PACKAGE_MII_DIAG=y
BR2_PACKAGE_NET_TOOLS=y
# BR2_PACKAGE_SYSTEMD_VCONSOLE is not set
BR2_TARGET_ROOTFS_EXT2=y
BR2_TARGET_ROOTFS_EXT2_4=y
BR2_TARGET_ROOTFS_EXT2_SIZE="230M"
BR2_TARGET_UBOOT=y
BR2_TARGET_UBOOT_BUILD_SYSTEM_KCONFIG=y
BR2_TARGET_UBOOT_CUSTOM_VERSION=y
BR2_TARGET_UBOOT_CUSTOM_VERSION_VALUE="2019.04-rc4"
BR2_TARGET_UBOOT_PATCH="${BR2_EXTERNAL_BeagleBone_AI_PATH}/patches/uboot/"
BR2_TARGET_UBOOT_BOARD_DEFCONFIG="am57xx_evm"
BR2_TARGET_UBOOT_NEEDS_DTC=y
# BR2_TARGET_UBOOT_FORMAT_BIN is not set
BR2_TARGET_UBOOT_FORMAT_DTB_IMG=y
BR2_TARGET_UBOOT_SPL=y
BR2_TARGET_UBOOT_SPL_NAME="MLO"
BR2_PACKAGE_HOST_DOSFSTOOLS=y
BR2_PACKAGE_HOST_GENIMAGE=y
BR2_PACKAGE_HOST_MTOOLS=y
BR2_PACKAGE_HOST_UBOOT_TOOLS=y
BR2_PACKAGE_BCMDHD=y
```

## SW/buildroot/local/package/bcmdhd/Config.in
```kconfig
config BR2_PACKAGE_BCMDHD
	bool "bcmdhd"
	depends on BR2_LINUX_KERNEL
	help
		Broadcom/Cypress out-of-tree wifi module driver
```
